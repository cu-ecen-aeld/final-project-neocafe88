## base_external/Config.in
```kconfig
source "$BR2_EXTERNAL_project_base_PATH/package/aesd-assignments/Config.in"
source "$BR2_EXTERNAL_project_base_PATH/package/ldd/Config.in"
source "$BR2_EXTERNAL_project_base_PATH/package/aesdchar/Config.in"
source "$BR2_EXTERNAL_project_base_PATH/package/aws-iot-device-sdk-cpp-v2/Config.in"
source "$BR2_EXTERNAL_project_base_PATH/package/temp-sensor/Config.in"
```

## base_external/package/aesdchar/Config.in
```kconfig
config BR2_PACKAGE_AESDCHAR
	bool "aesdchar"
	help
	  AESDCHAR driver modules from assignment 8
  	  Used to understand buildroot external trees and package builds.
```

## base_external/package/aws-iot-device-sdk-cpp-v2/Config.in
```kconfig
config BR2_PACKAGE_AWS_IOT_DEVICE_SDK_CPP_V2
	bool "aws-iot-device-sdk-cpp-v2"
	help
	  SDK for AWS IoT Core
```

## base_external/package/ldd/Config.in
```kconfig
config BR2_PACKAGE_LDD
	bool "ldd"
	help
	  LDD modules from assignment 7
  	  Used to understand buildroot external trees and package builds.
```

## base_external/package/temp-sensor/Config.in
```kconfig
config BR2_PACKAGE_TEMP_SENSOR
        bool "temp-sensor"
        help
          Reades temeperatures from a conntected to the sensor and
	  publish them to AWS IoT Core.
```

## base_external/package/tempdriver/Config.in
```kconfig
config BR2_PACKAGE_TEMPDRIVER
        bool "tempdriver"
        help
          TEMP driver modules for the final project
```
